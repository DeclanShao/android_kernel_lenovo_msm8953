## techpack/Kconfig
```kconfig
source "techpack/camera-legacy-n/Kconfig"
source "techpack/lenovo-msm8953/Kconfig"
```

## techpack/lenovo-msm8953/Kconfig
```kconfig
config MACH_LENOVO_MSM8953
	bool "Support for Lenovo MSM8953 platform"
	help
	  Say Y here to enable support for Lenovo MSM8953 platform.

source "techpack/lenovo-msm8953/touchscreen/Kconfig"
source "techpack/lenovo-msm8953/misc/Kconfig"
```

## techpack/lenovo-msm8953/misc/Kconfig
```kconfig
config INPUT_IQS263
	tristate "IQS263 Capacitive Touch Controller Driver"
	help
	  Say Y here if you want to support iqs263 touch sensor.

	  You should select a bus connection too.

	  To compile this driver as a module, choose M here: the
	  module will be called iqs263.
```

## techpack/lenovo-msm8953/touchscreen/Kconfig
```kconfig
source "techpack/lenovo-msm8953/touchscreen/hx852xf/Kconfig"

config TOUCHSCREEN_HIMAX_HX852XF
	tristate "Analog Devices AD7879-1/AD7889-1 touchscreen interface"
	help
	  Say Y here if you want to support a touchscreen interface using
	  the AD7879-1/AD7889-1 controller.

	  You should select a bus connection too.

	  To compile this driver as a module, choose M here: the
	  module will be called ad7879.
	  
config TOUCHSCREEN_HIMAX_HX852XF_DEBUG
	tristate "Analog Devices AD7879-1/AD7889-1 touchscreen interface"
	help
	  Say Y here if you want to support a touchscreen interface using
	  the AD7879-1/AD7889-1 controller.

	  You should select a bus connection too.

	  To compile this driver as a module, choose M here: the
	  module will be called ad7879.
```

## techpack/lenovo-msm8953/touchscreen/hx852xf/Kconfig
```kconfig
#
# Himax Touchscreen driver configuration
#

config TOUCHSCREEN_HIMAX_HX852XF
	tristate "HIMAX HX852xF I2C touchscreen"
	depends on I2C
	help
	  Enable support for Himax HX852xF I2C touchscreen controllers.

config TOUCHSCREEN_HIMAX_HX852XF_DEBUG
	bool "HIMAX HX852xF debug support"
	depends on TOUCHSCREEN_HIMAX_HX852XF=y
	help
	  Enable debug and procfs interfaces for the Himax HX852xF driver.

config TOUCHSCREEN_HIMAX_HX852XF_SMART_WAKEUP
	bool "HIMAX HX852xF double-tap wake support"
	depends on TOUCHSCREEN_HIMAX_HX852XF && MACH_LENOVO_TB8703
	default n
	help
	  Enable the optional double-tap-to-wake feature for the Lenovo TB8703.
	  The feature is disabled at runtime by default and can be enabled through
	  the driver's double_tap_wake sysfs attribute.

config HMX_DB
	tristate "HIMAX driver test over Dragon Board"
	depends on I2C
	help
	  This enables support for HIMAX driver test over Dragon Board.
```
